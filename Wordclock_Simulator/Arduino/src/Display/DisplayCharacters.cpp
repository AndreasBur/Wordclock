/******************************************************************************************************************************************************
 *  COPYRIGHT
 *  ---------------------------------------------------------------------------------------------------------------------------------------------------
 *  \verbatim
 *  Copyright (c) Andreas Burnickl                                                                                                 All rights reserved.
 *
 *  \endverbatim
 *  ---------------------------------------------------------------------------------------------------------------------------------------------------
 *  FILE DESCRIPTION
 *  -------------------------------------------------------------------------------------------------------------------------------------------------*/
/**     \file       DisplayCharacters.cpp
 *      \brief      
 *
 *      \details    
 *                  
 *
******************************************************************************************************************************************************/
#define _DISPLAY_CHARACTERS_SOURCE_

/******************************************************************************************************************************************************
 * INCLUDES
******************************************************************************************************************************************************/
#include "DisplayCharacters.h"


/******************************************************************************************************************************************************
 *  LOCAL CONSTANT MACROS
******************************************************************************************************************************************************/


/******************************************************************************************************************************************************
 *  LOCAL FUNCTION MACROS
******************************************************************************************************************************************************/



/******************************************************************************************************************************************************
 *  LOCAL DATA TYPES AND STRUCTURES
******************************************************************************************************************************************************/
const DisplayCharacters::DisplayCharactersTableElementType DisplayCharacters::DisplayCharactersTable[][DISPLAY_CHARACTERS_NUMBER_OF_COLUMNS + 1] PROGMEM
{
    "ESKISTLFÜNF",
    "ZEHNZWANZIG",
    "DREIVIERTEL",
    "TGNACHVORJM",
    "HALBQZWÖLFP",
    "ZWEINSIEBEN",
    "KDREIRHFÜNF",
    "ELFNEUNVIER",
    "WACHTZEHNRS",
    "BSECHSFMUHR"
};


/******************************************************************************************************************************************************
 * P U B L I C   F U N C T I O N S
******************************************************************************************************************************************************/

/******************************************************************************************************************************************************
  getCharacter()
******************************************************************************************************************************************************/
StdReturnType DisplayCharacters::getCharacter(byte Column, byte Row, char& Character) const
{
    if(Row < DISPLAY_CHARACTERS_NUMBER_OF_ROWS && Column < DISPLAY_CHARACTERS_NUMBER_OF_COLUMNS) {
        Character =  getCharacterFast(Row, Column);
        return E_OK;
    } else {
        return E_NOT_OK;
    }
} /* getCharacter */


/******************************************************************************************************************************************************
  getCharacter()
  ****************************************************************************************************************************************************/
StdReturnType DisplayCharacters::getCharacter(byte Index, char& Character) const
{
    byte Row, Column;
    indexToColumnAndRow(Index, Column, Row);

    if(isIndexValid(Index)) {
        Character =  getCharacterFast(Row, Column);
        return E_OK;
    } else {
        return E_NOT_OK;
    }
} /* getCharacter */


/******************************************************************************************************************************************************
  getCharacter()
  ****************************************************************************************************************************************************/
StdReturnType DisplayCharacters::getCharacter(CharacterIdType CharacterId, char& Character) const
{
    byte Row, Column;
    indexToColumnAndRow(CharacterId, Column, Row);

    if(isCharacterIdValid(CharacterId)) {
        Character =  getCharacterFast(CharacterId);
        return E_OK;
    } else {
        return E_NOT_OK;
    }
} /* getCharacter */


/******************************************************************************************************************************************************
 * P R I V A T E   F U N C T I O N S
******************************************************************************************************************************************************/



/******************************************************************************************************************************************************
 *  E N D   O F   F I L E
******************************************************************************************************************************************************/
 