/******************************************************************************************************************************************************
 *  COPYRIGHT
 *  ---------------------------------------------------------------------------------------------------------------------------------------------------
 *  \verbatim
 *  Copyright (c) Andreas Burnickl                                                                                                 All rights reserved.
 *
 *  \endverbatim
 *  ---------------------------------------------------------------------------------------------------------------------------------------------------
 *  FILE DESCRIPTION
 *  -------------------------------------------------------------------------------------------------------------------------------------------------*/
/**     \file       FontChar.h
 *      \brief      
 *
 *      \details    
 *                  
******************************************************************************************************************************************************/
#ifndef _FONT_CHAR_H_
#define _FONT_CHAR_H_

/******************************************************************************************************************************************************
 * I N C L U D E S
******************************************************************************************************************************************************/
#include "StandardTypes.h"
#include "Arduino.h"
#include <array>

/******************************************************************************************************************************************************
 *  G L O B A L   C O N S T A N T   M A C R O S
******************************************************************************************************************************************************/
/* FontChar configuration parameter */


/* FontChar parameter */



/******************************************************************************************************************************************************
 *  G L O B A L   F U N C T I O N   M A C R O S
******************************************************************************************************************************************************/


/******************************************************************************************************************************************************
 *  C L A S S   F O N T C H A R
******************************************************************************************************************************************************/
class FontChar
{
/******************************************************************************************************************************************************
 *  P U B L I C   D A T A   T Y P E S   A N D   S T R U C T U R E S
******************************************************************************************************************************************************/
  public:
  
  
/******************************************************************************************************************************************************
 *  P R I V A T E   D A T A   A N D   F U N C T I N O N S
******************************************************************************************************************************************************/
  private:
    byte Width;

/******************************************************************************************************************************************************
 *  P R O T E C T E D   D A T A   A N D   F U N C T I N O N S
******************************************************************************************************************************************************/
  protected:
    constexpr FontChar() : Width(0u) {

    }

    constexpr FontChar(byte sWidth) : Width(sWidth) {

    }


/******************************************************************************************************************************************************
 *  P U B L I C   F U N C T I O N S
******************************************************************************************************************************************************/
  public:
    // get methods
    byte getWidth() const { return Width; }

    // set methods
    void setWidth(byte sWidth) { Width = sWidth; }

    // methods
};


/******************************************************************************************************************************************************
 *  C L A S S   F O N T C H A R H O R I Z O N T A L
******************************************************************************************************************************************************/
template <typename RowType, byte RowsSize> class FontCharHorizontal : public FontChar
{
/******************************************************************************************************************************************************
 *  P U B L I C   D A T A   T Y P E S   A N D   S T R U C T U R E S
******************************************************************************************************************************************************/
  public:

  
/******************************************************************************************************************************************************
 *  P R I V A T E   D A T A   A N D   F U N C T I N O N S
******************************************************************************************************************************************************/
  private:
    using RowsType = std::array<RowType, RowsSize>;
    RowsType Rows;

/******************************************************************************************************************************************************
 *  P U B L I C   F U N C T I O N S
******************************************************************************************************************************************************/
  public:
    constexpr FontCharHorizontal(byte sWidth, std::array<RowType, RowsSize> sRows) : FontChar(sWidth), Rows(sRows) {

    }

    constexpr FontCharHorizontal() : FontChar(0u), Rows{} {
    
    }

    // get methods
    RowType getRowFast(byte Index) const { return Rows[Index]; }
    StdReturnType getRow(byte Index, RowType& Row) const {
        if(Index < RowsSize) {
            Row = Rows[Index];
            return E_OK;
        } else {
            return E_NOT_OK;
        }
    }
    RowsType getRows() const { return Rows; }

    // set methods
    void setRowFast(byte Index, RowType Row) { Rows[Index] = Row; }
    StdReturnType setRow(byte Index, RowType Row) const {
        if(Index < RowsSize) {
            Rows[Index] = Row;
            return E_OK;
        } else {
            return E_NOT_OK;
        }
    }
    void setRows(RowsType sRows) { Rows = sRows; }

    // methods

};


/******************************************************************************************************************************************************
 *  C L A S S   F O N T C H A R V E R T I C A L
******************************************************************************************************************************************************/
template <typename ColumnType, byte ColumnsSize> class FontCharVertical : public FontChar
{
/******************************************************************************************************************************************************
 *  P U B L I C   D A T A   T Y P E S   A N D   S T R U C T U R E S
******************************************************************************************************************************************************/
  public:

  
/******************************************************************************************************************************************************
 *  P R I V A T E   D A T A   A N D   F U N C T I N O N S
******************************************************************************************************************************************************/
  private:
    using ColumnsType = std::array<ColumnType, ColumnsSize>;
    ColumnsType Columns;

/******************************************************************************************************************************************************
 *  P U B L I C   F U N C T I O N S
******************************************************************************************************************************************************/
  public:
    constexpr FontCharVertical(byte sWidth, std::array<ColumnType, ColumnsSize> sColumns) : FontChar(sWidth), Columns(sColumns) {

    }

    constexpr FontCharVertical() : FontChar(0), Columns{} {
    
    }

    // get methods
    ColumnType getColumnFast(byte Index) const { return Columns[Index]; }
    StdReturnType getColumn(byte Index, ColumnType& Column) const {
        if(Index < ColumnsSize) {
            Column = Columns[Index];
            return E_OK;
        } else {
            return E_NOT_OK;
        }
    }
    ColumnsType getColumns() const { return Columns; }

    // set methods
    void setColumnFast(byte Index, ColumnType Column) { Columns[Index] = Column; }
    StdReturnType setColumn(byte Index, ColumnType Column) const {
        if(Index < ColumnsSize) {
            Columns[Index] = Column;
            return E_OK;
        } else {
            return E_NOT_OK;
        }
    }
    void setColumns(ColumnsType sColumns) { Columns = sColumns; }

    // methods

};


#endif
/******************************************************************************************************************************************************
 *  E N D   O F   F I L E
******************************************************************************************************************************************************/
